/**
 * @cliArgs --device "MSPM0C110X" --part "Default" --package "VSSOP-20(DGS20)" --product "mspm0_sdk@2.08.00.02"
 * @versions {"tool":"1.25.0+4268"}
 */

/**
 * Import the modules used in this configuration.
 */
const ADC12    = scripting.addModule("/ti/driverlib/ADC12", {}, false);
const ADC121   = ADC12.addInstance();
const Board    = scripting.addModule("/ti/driverlib/Board");
const GPIO     = scripting.addModule("/ti/driverlib/GPIO", {}, false);
const GPIO1    = GPIO.addInstance();
const GPIO2    = GPIO.addInstance();
const uartLIN  = scripting.addModule("/ti/driverlib/uartLIN", {}, false);
const uartLIN1 = uartLIN.addInstance();

/**
 * Write custom configuration values to the imported modules.
 */
ADC121.$name                 = "ADC12_0";
ADC121.enableDMA             = false;
ADC121.repeatMode            = true;
ADC121.enabledInterrupts     = ["DL_ADC12_INTERRUPT_MEM0_RESULT_LOADED"];
ADC121.sampleTime0           = "62.5ns";
ADC121.samplingOperationMode = "sequence";
ADC121.endAdd                = 3;
ADC121.adcMem0chansel        = "DL_ADC12_INPUT_CHAN_2";
ADC121.enabledADCMems        = [0,1];
ADC121.adcMem1chansel        = "DL_ADC12_INPUT_CHAN_3";
ADC121.adcPin2Config.$name   = "ti_driverlib_gpio_GPIOPinGeneric2";
ADC121.adcPin3Config.$name   = "ti_driverlib_gpio_GPIOPinGeneric3";


GPIO1.$name                          = "GPIO_LEDS";
GPIO1.port                           = "PORTA";
GPIO1.portSegment                    = "Lower";
GPIO1.associatedPins[0].$name        = "USER_LED_1";
GPIO1.associatedPins[0].assignedPin  = "4";
GPIO1.associatedPins[0].invert       = "ENABLE";
GPIO1.associatedPins[0].initialValue = "SET";

GPIO2.$name                         = "GPIO_LIN_ENABLE";
GPIO2.port                          = "PORTA";
GPIO2.portSegment                   = "Upper";
GPIO2.associatedPins[0].assignedPin = "17";
GPIO2.associatedPins[0].$name       = "USER_LIN_ENABLE";

const SYSCTL = scripting.addModule("/ti/driverlib/SYSCTL", {}, false);

uartLIN1.$name                                  = "LIN_0";
uartLIN1.targetBaudRate                         = 19200;
uartLIN1.enableLinCounter                       = true;
uartLIN1.enableLinCounterClearFallingEdge       = true;
uartLIN1.enableLinCountWhileLow                 = true;
uartLIN1.enableLinCounterCompare                = true;
uartLIN1.tbitVal                                = 9.5;
uartLIN1.profile                                = "CONFIG_PROFILE_1";
uartLIN1.peripheral.rxPin.$assign               = "PA26";
uartLIN1.peripheral.txPin.$assignAllowConflicts = "PA27";
uartLIN1.txPinConfig.$name                      = "ti_driverlib_gpio_GPIOPinGeneric0";
uartLIN1.rxPinConfig.$name                      = "ti_driverlib_gpio_GPIOPinGeneric1";

/**
 * Pinmux solution for unlocked pins/peripherals. This ensures that minor changes to the automatic solver in a future
 * version of the tool will not impact the pinmux you originally saw.  These lines can be completely deleted in order to
 * re-solve from scratch.
 */
ADC121.peripheral.$suggestSolution           = "ADC0";
ADC121.peripheral.adcPin2.$suggestSolution   = "PA25";
ADC121.peripheral.adcPin3.$suggestSolution   = "PA24";
Board.peripheral.$suggestSolution            = "DEBUGSS";
Board.peripheral.swclkPin.$suggestSolution   = "PA20";
Board.peripheral.swdioPin.$suggestSolution   = "PA19";
GPIO1.associatedPins[0].pin.$suggestSolution = "PA4";
GPIO2.associatedPins[0].pin.$suggestSolution = "PA17";
SYSCTL.peripheral.$suggestSolution           = "SYSCTL";
uartLIN1.peripheral.$suggestSolution         = "UART0";
