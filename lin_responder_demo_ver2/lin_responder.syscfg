/**
 * @cliArgs --device "MSPM0C110X" --part "Default" --package "VSSOP-20(DGS20)" --product "mspm0_sdk@2.07.00.06"
 * @versions {"tool":"1.25.0+4268"}
 */

/**
 * Import the modules used in this configuration.
 */
const Board    = scripting.addModule("/ti/driverlib/Board");
const GPIO     = scripting.addModule("/ti/driverlib/GPIO", {}, false);
const GPIO1    = GPIO.addInstance();
const GPIO2    = GPIO.addInstance();
const uartLIN  = scripting.addModule("/ti/driverlib/uartLIN", {}, false);
const uartLIN1 = uartLIN.addInstance();

/**
 * Write custom configuration values to the imported modules.
 */

GPIO1.$name                          = "GPIO_LEDS";
GPIO1.port                           = "PORTA";
GPIO1.portSegment                    = "Lower";
GPIO1.associatedPins[0].$name        = "USER_LED_1";
GPIO1.associatedPins[0].assignedPin  = "4";
GPIO1.associatedPins[0].invert       = "ENABLE";
GPIO1.associatedPins[0].initialValue = "SET";

GPIO2.$name                         = "GPIO_LIN_ENABLE";
GPIO2.port                          = "PORTA";
GPIO2.portSegment                   = "Upper";
GPIO2.associatedPins[0].assignedPin = "17";
GPIO2.associatedPins[0].$name       = "USER_LIN_ENABLE";

const SYSCTL = scripting.addModule("/ti/driverlib/SYSCTL", {}, false);

uartLIN1.$name                                  = "LIN_0";
uartLIN1.targetBaudRate                         = 19200;
uartLIN1.enableLinCounter                       = true;
uartLIN1.enableLinCounterClearFallingEdge       = true;
uartLIN1.enableLinCountWhileLow                 = true;
uartLIN1.enableLinCounterCompare                = true;
uartLIN1.tbitVal                                = 9.5;
uartLIN1.profile                                = "CONFIG_PROFILE_1";
uartLIN1.peripheral.rxPin.$assign               = "PA26";
uartLIN1.peripheral.txPin.$assignAllowConflicts = "PA27";
uartLIN1.txPinConfig.$name                      = "ti_driverlib_gpio_GPIOPinGeneric0";
uartLIN1.rxPinConfig.$name                      = "ti_driverlib_gpio_GPIOPinGeneric1";

/**
 * Pinmux solution for unlocked pins/peripherals. This ensures that minor changes to the automatic solver in a future
 * version of the tool will not impact the pinmux you originally saw.  These lines can be completely deleted in order to
 * re-solve from scratch.
 */
Board.peripheral.$suggestSolution            = "DEBUGSS";
Board.peripheral.swclkPin.$suggestSolution   = "PA20";
Board.peripheral.swdioPin.$suggestSolution   = "PA19";
GPIO1.associatedPins[0].pin.$suggestSolution = "PA4";
GPIO2.associatedPins[0].pin.$suggestSolution = "PA17";
SYSCTL.peripheral.$suggestSolution           = "SYSCTL";
uartLIN1.peripheral.$suggestSolution         = "UART0";
